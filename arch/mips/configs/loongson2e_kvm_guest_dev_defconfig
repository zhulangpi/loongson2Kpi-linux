## arch/mips/loongson2/ls2k/Kconfig
```kconfig
if MACH_LOONGSON2K

choice
	prompt "Machine Type"

config LOONGSON_MACH2K
	bool "Generic Loongson 2k family machines"
	select ARCH_SPARSEMEM_ENABLE
	select GENERIC_ISA_DMA_SUPPORT_BROKEN
	select BOOT_ELF32
	select BOARD_SCACHE
	select CSRC_R4K
	select CEVT_R4K
	select CPU_HAS_WB
	select HW_HAS_PCI
	select IRQ_CPU
	select SYS_HAS_CPU_LOONGSON2K
	select SYS_HAS_EARLY_PRINTK
	select SYS_SUPPORTS_SMP
	select SYS_SUPPORTS_64BIT_KERNEL
	select SYS_SUPPORTS_HIGHMEM
	select SYS_SUPPORTS_LITTLE_ENDIAN
	select ZONE_DMA32
	select UEFI_FIRMWARE_INTERFACE
	select SYS_SUPPORTS_HOTPLUG_CPU
	select SYNC_R4K
	#select DMA_NONCOHERENT
	#select ARCH_REQUIRE_GPIOLIB
	select ARCH_REQUIRE_GPIOLIB
	select NEED_SG_DMA_LENGTH
	select ARCH_SUPPORTS_MSI
	help
		Generic Loongson 2K family machines utilize the 3A/3B revision of
		Loongson processor and RS780/SBX00/2H chipset.
endchoice

config SWIOTLB
	bool "Soft IOMMU Support for Big Memory (>4GB)"
	depends on CPU_LOONGSON2K
	select IOMMU_HELPER
	select NEED_SG_DMA_LENGTH
	select NEED_DMA_MAP_STATE

config LOONGSON_DMA_NONCOHERENT
	bool "Loongson dma noncoherent"
	select DMA_NONCOHERENT
	default n

config NEED_SG_DMA_LENGTH
	bool

config ARCH_SPARSEMEM_ENABLE
	bool
	select SPARSEMEM_STATIC

config UEFI_FIRMWARE_INTERFACE
	bool

config LS2K_HPET
	bool "LS2K HPET Timer"
	depends on CPU_LOONGSON2K
	select MIPS_EXTERNAL_TIMER
	help
		This option enables the hpet timer of LS2K.
endif # MACH_LOONGSON2K
```

## arch/mips/loongson3/Kconfig
```kconfig
if MACH_LOONGSON3

choice
	prompt "Machine Type"

config LOONGSON_MACH3X
	bool "Generic Loongson 3 family machines"
	select ARCH_SPARSEMEM_ENABLE
	select GENERIC_ISA_DMA_SUPPORT_BROKEN
	select BOOT_ELF32
	select BOARD_SCACHE
	select CSRC_R4K
	select CEVT_R4K
	select CPU_HAS_WB
	select HW_HAS_PCI
	select LS2H_SB
	select ISA
	select HT_PCI
	select I8259
	select IRQ_CPU
	select NR_CPUS_DEFAULT_4
	select SYS_HAS_CPU_LOONGSON3
	select SYS_HAS_EARLY_PRINTK
	select SYS_SUPPORTS_SMP
	select SYS_SUPPORTS_64BIT_KERNEL
	select SYS_SUPPORTS_HIGHMEM
	select SYS_SUPPORTS_LITTLE_ENDIAN
	select ZONE_DMA32
	select UEFI_FIRMWARE_INTERFACE
	select SYS_SUPPORTS_HOTPLUG_CPU
	select SYS_SUPPORTS_NUMA
	select PHYS48_TO_HT40
	select SYNC_R4K
	select LOONGSON_MC146818
	select ARCH_REQUIRE_GPIOLIB
	select ARCH_SUPPORTS_MSI
	help
		Generic Loongson 3 family machines utilize the 3A/3B revision of
		Loongson processor and RS780/SBX00/2H chipset.
endchoice

config RS780_HPET
	bool "RS780/SBX00 HPET Timer"
	depends on LOONGSON_MACH3X
	select MIPS_EXTERNAL_TIMER
	help
	  This option enables the hpet timer of AMD RS780/SBX00.

	  If you want to enable the Loongson3 CPUFreq Driver, Please enable
	  this option at first, otherwise, You will get wrong system time.

	  If unsure, say Yes.

config LOONGSON_SUSPEND
	bool
	default y
	depends on CPU_SUPPORTS_CPUFREQ && SUSPEND

config LOONGSON_UART_BASE
	bool
	default y
	depends on EARLY_PRINTK || SERIAL_8250

config IOMMU_HELPER
	bool

config NEED_SG_DMA_LENGTH
	bool

config SWIOTLB
	bool "Soft IOMMU Support for Big Memory (>4GB)"
	depends on CPU_LOONGSON3
	select IOMMU_HELPER
	select NEED_SG_DMA_LENGTH
	select NEED_DMA_MAP_STATE

config LOONGSON_MC146818
	bool
	default n

config ARCH_SPARSEMEM_ENABLE
	bool
	select SPARSEMEM_STATIC

config UEFI_FIRMWARE_INTERFACE
	bool

config PHYS48_TO_HT40
	bool
	default y if CPU_LOONGSON3

config PHASE_LOCK
	bool "Loongson3 Hierarchical Lock Support"
	default y
	depends on CPU_LOONGSON3
	help
	  Say Y to compile the kernel to support hierarchical lock (PHASE_LOCK).
	  This option improves performance on systems with more than two nodes.

config LS2H_SB
	bool

config LOONGSON_DMA_NONCOHERENT
	bool "Loongson dma noncoherent"
	select DMA_NONCOHERENT
	default n

config PCI_MSI_IRQ_BALANCE
        bool "pci msi irq balance"
        depends on PCI_MSI
        default y

endif # MACH_LOONGSON3
```

## drivers/misc/loongson/Kconfig
```kconfig
#
# MIPS Platform Specific Drivers
#

menuconfig LOONGSON_EC_DEVICES
	bool "LOONGSON Platform EC Device Drivers"
	default y
	depends on MIPS
	---help---
	  Say Y here to get to see options for ec device drivers for loongson
	  platforms.
	  This option alone does not add any kernel code.

	  If you say N, all options in this submenu will be skipped and disabled.

if LOONGSON_EC_DEVICES

config LOONGSON_LAPTOP
	tristate "Loongson Laptop pm and hotkey driver"
	depends on CPU_LOONGSON3
	select BACKLIGHT_CLASS_DEVICE
	select LCD_CLASS_DEVICE
	select BACKLIGHT_LCD_SUPPORT
	select VIDEO_OUTPUT_CONTROL
	depends on INPUT
	select INPUT_SPARSEKMAP
	select INPUT_EVDEV
	default y
	---help---
	  This is a driver for Loongson laptops, include power and hotkey
	  driver;
endif
```

## sound/loongson/Kconfig
```kconfig
menuconfig SND_HDA_LS2H
	bool "Loongson2H HD Audio"
	depends on LS2H_SB || MACH_LOONGSON2K
	select SND_PCM
	select SND_VMASTER
	help
	  Say Y here to include support for "Loongson2H High Definition
	  Audio".

if SND_HDA_LS2H

config LS2H_HDA_POWER_SAVE
	bool "Aggressive power-saving on HD-audio"
	help
	  Say Y here to enable more aggressive power-saving mode on
	  HD-audio driver.  The power-saving timeout can be configured
	  via power_save option or over sysfs on-the-fly.

config LS2H_HDA_POWER_SAVE_DEFAULT
	int "Default time-out for HD-audio power-save mode"
	depends on LS2H_HDA_POWER_SAVE
	default 0
	  help
	  The default time-out value in seconds for HD-audio automatic
	  power-save mode.  0 means to disable the power-save mode.

endif
```

## sound/soc/loongson/Kconfig
```kconfig
config SND_LS2K
	tristate "SoC Audio for the LS2K chip"
	depends on MACH_LOONGSON2K
	help
	  Say Y or M if you want to add support for codecs attached to
	  the PXA2xx AC97, I2S or SSP interface. You will also need
	  to select the audio interfaces to support below.


choice
	prompt "ls2k codec"
	default SND_LS2K_UDA1342
	depends on SND_LS2K
config SND_LS2K_UDA1342
	bool "uda1342 codec"
	select SND_SOC_UDA1342
config SND_LS2K_RT5651
	bool "rt5651 codec"
	select SND_SOC_RT5651
endchoice 
```
